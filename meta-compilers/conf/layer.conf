## meta-compilers/conf/layer.conf
```bitbake
BBPATH .= ":${LAYERDIR}"
BBFILES += " \
    ${LAYERDIR}/recipes-*/*/*.bb \
    ${LAYERDIR}/recipes-*/*/*.bbappend \
"

BBFILE_COLLECTIONS += "compilerports"
BBFILE_PATTERN_compilerports = "^${LAYERDIR}/"
BBFILE_PRIORITY_compilerports = "5"

LAYERVERSION_compilerports = "1"

LAYERDEPENDS_compilerports = "core"
```

## meta-gcc49/conf/layer.conf
```bitbake
BBPATH .= ":${LAYERDIR}"
BBFILES += " \
    ${LAYERDIR}/recipes-*/*/*.bb \
    ${LAYERDIR}/recipes-*/*/*.bbappend \
"

BBFILE_COLLECTIONS += "port-gcc49"
BBFILE_PATTERN_port-gcc49 = "^${LAYERDIR}/"
BBFILE_PRIORITY_port-gcc49 = "5"

LAYERVERSION_port-gcc49 = "1"

LAYERDEPENDS_port-gcc49 = "core"
```
